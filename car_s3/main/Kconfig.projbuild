## car_s3/main/Kconfig.projbuild
```kconfig
menu "SZPI car hardware"
config RC_MOTOR_ENABLE
    bool "Enable external PCA9685 + TB6612 motor adapter"
    default y
config RC_MOTOR_INVERT_LEFT
    bool "Invert left motor polarity"
    default n
config RC_MOTOR_INVERT_RIGHT
    bool "Invert right motor polarity"
    default n
config RC_CAMERA_JPEG_QUALITY
    int "Software JPEG quality (GC0308 is not a JPEG sensor)"
    range 20 90
    default 55
endmenu
```

## components/rc_common/Kconfig
```kconfig
menu "Camera car link"
config RC_WIFI_SSID
    string "Car access point SSID"
    default "SZPI-P4-Car"
config RC_WIFI_PASSWORD
    string "Car access point password (8-63 characters)"
    default "CarVideo2026"
config RC_SPEAKER_VOLUME
    int "Initial speaker volume"
    range 0 65
    default 40
config RC_MIC_GAIN_DB
    int "Microphone gain in dB"
    range 0 36
    default 24
config RC_REF_GAIN_DB
    int "S3 analog echo reference gain in dB"
    range 0 24
    default 0
endmenu
```

## remote_p4/sdkconfig.defaults
```kconfig
CONFIG_IDF_TARGET="esp32p4"
CONFIG_ESPTOOLPY_FLASHSIZE_16MB=y
CONFIG_SPIRAM=y
CONFIG_SPIRAM_SPEED_200M=y
CONFIG_SPIRAM_MALLOC_ALWAYSINTERNAL=1024
CONFIG_SPIRAM_MALLOC_RESERVE_INTERNAL=65536
CONFIG_PARTITION_TABLE_CUSTOM=y
CONFIG_PARTITION_TABLE_CUSTOM_FILENAME="partitions.csv"
CONFIG_FREERTOS_HZ=1000
CONFIG_ESP_MAIN_TASK_STACK_SIZE=8192
CONFIG_BSP_LCD_TYPE_1024_600=y
CONFIG_LV_COLOR_DEPTH_16=y
CONFIG_LV_USE_SYSMON=n
CONFIG_LV_FONT_MONTSERRAT_24=y
CONFIG_LV_FONT_MONTSERRAT_32=y
CONFIG_ESP_WIFI_REMOTE_ENABLED=y
CONFIG_ESP_WIFI_REMOTE_LIBRARY_HOSTED=y
CONFIG_ESP_HOSTED_P4_DEV_BOARD_FUNC_BOARD=y
CONFIG_ESP32P4_SELECTS_REV_LESS_V3=y
CONFIG_ESP32P4_REV_MIN_0=y
```
